## CMakeLists.txt
```
cmake_minimum_required(VERSION 3.20.0)

find_package(Zephyr REQUIRED HINTS $ENV{ZEPHYR_BASE})
if (NOT SYSBUILD)
    message(WARNING
        " This is multi-image application that should be build using sysbuild.\n"
        " Add --sysbuild argument to west build command to prepare all the images.")
endif()

project(monitoring-tool)

target_sources(app PRIVATE src/main.c)

# Include your project headers
target_include_directories(app PRIVATE include)
include_directories(include/libs)
include_directories(include/driver)

add_subdirectory(src/libs)
add_subdirectory(src/driver)
```

## prj.conf
```kconfig
CONFIG_IPM=y
CONFIG_TIMESLICE_SIZE=1
CONFIG_MAIN_STACK_SIZE=2048
CONFIG_HEAP_MEM_POOL_SIZE=4096
CONFIG_RPMSG_SERVICE=y
CONFIG_RPMSG_SERVICE_MODE_MASTER=y
CONFIG_OPENAMP_SLAVE=n

# USB
CONFIG_STDOUT_CONSOLE=y
CONFIG_USB_DEVICE_STACK=y
CONFIG_USB_DEVICE_PRODUCT="Monitoring-tool"
CONFIG_USB_DRIVER_LOG_LEVEL_ERR=y
CONFIG_USB_DEVICE_LOG_LEVEL_ERR=y
CONFIG_UART_INTERRUPT_DRIVEN=y
CONFIG_UART_LINE_CTRL=y

# PRINT
CONFIG_PRINTK=y
CONFIG_LOG=y
CONFIG_CBPRINTF_FP_SUPPORT=y
CONFIG_LOG_DEFAULT_LEVEL=1
# CONFIG_USE_SEGGER_RTT=y
# CONFIG_LOG_BACKEND_RTT=y
CONFIG_LOG_BACKEND_UART=y
```

## src/main.c
```c
/* ================================================================================================================== */
/* [INCL] Includes                                                                                                    */
/* ================================================================================================================== */
/* ----------------------------------  Standard  -------------------------------------------------------------------- */
#include <stdio.h>
#include <stdlib.h>
#include <string.h>
/* ------------------------------------  SDK  ----------------------------------------------------------------------- */
#include <zephyr/sys/printk.h>
/* -----------------------------------  Plejd  ---------------------------------------------------------------------- */

/* -----------------------------------  Local  ---------------------------------------------------------------------- */
#include <packet.h>
#include <compact_fifo_mutex.h>
#include <driver/usb.h>
#include <zephyr/logging/log.h>
LOG_MODULE_REGISTER(main_module, LOG_LEVEL_DBG);
/* ================================================================================================================== */
/* [DEFS] Defines                                                                                                     */
/* ================================================================================================================== */

/* ================================================================================================================== */
/* [TYPE] Type definitions                                                                                            */
/* ================================================================================================================== */
#define SEND_KEYS_PROTOCOL     		0xFF
#define MESH_COMMAND_PROTOCOL 		0xFE
#define MESH_START_STOP_PROTOCOL 	0xFD
/* ================================================================================================================== */
/* [GLOB] Global variables                                                                                            */
/* ================================================================================================================== */
static compact_fifo_t* rx_fifo = (uint32_t *)0x20070000;
static compact_fifo_t* tx_fifo = (uint32_t *)0x20075000;
static uint8_t* start = (uint32_t *)0x20079000;
static uint8_t* end = (uint32_t *)0x20079004;
/* ================================================================================================================== */
/* [PFDE] Private functions declaration                                                                               */
/* ================================================================================================================== */
static void usb_to_mesh_callback(uint8_t *data);
/* ================================================================================================================== */
/* [PFUN] Private functions implementations                                                                           */
/* ================================================================================================================== */
static void append_rbc_header(mesh_package_format_t* packet, uint8_t* payload_length, uint16_t index, uint16_t version)
{
	
}

static void append_phy_header(mesh_package_format_t* packet, uint8_t* payload_length)
{
	
}

static void usb_to_mesh_callback(uint8_t *data)
{
	if (data[0] == SEND_KEYS_PROTOCOL) {
		printk("Keys received\n");
		uint32_t res = compact_fifo_mutex_push(tx_fifo, (void*)data);

		if (res != CFIFO_OK) {
			printk("Failed to push keys data to usb_mesh FIFO\n");
		}
		return;
	} 
	else if (data[0] == MESH_COMMAND_PROTOCOL) {
		// Payload length = mesh_version + flags + command + payload + crc
		// NOTE! Payload is encrypted
		uint8_t payload_length = data[1];

		mesh_package_format_t packet;
		memset(&packet, 0, sizeof(packet));
		memcpy(&packet.plejd, &data[2], payload_length);

		uint16_t index, version;
		memcpy(&index, &data[2 + payload_length], sizeof(packet.rbc_header.version));
		memcpy(&version, &data[2 + payload_length + sizeof(index)], sizeof(packet.rbc_header.version));

		append_rbc_header(&packet, &payload_length, index, version);
		append_phy_header(&packet, &payload_length);

		// Push to shared mem for NET core to access it
		uint32_t res = compact_fifo_mutex_push(tx_fifo, (void*)&packet);

		if (res != CFIFO_OK) {
			printk("Failed to push mesh packet to usb_mesh FIFO\n");
		}
	}
	else if (data[0] == MESH_START_STOP_PROTOCOL) {
		printk("Start/Stop received\n");
		*start = data[1];
	}
	else {
		printk("Unknown protocol\n");
	}
	
}
/* ================================================================================================================== */
/* [FUNC] Functions implementations                                                                                   */
/* ================================================================================================================== */
int main(void)
{
	printk("APP CORE: Starting application thread!\n");
	*start = 0;
	*end = 0;

	usb_init();

	set_usb_to_mesh_callback(&usb_to_mesh_callback);
	
	radio_packet_t packet;
	k_msleep(1000);

	uint32_t cntr = 0;
	while(true){

		if (*start == 0) {
			compact_fifo_mutex_clear(rx_fifo);
			usb_clear();
			cntr = 0;
		}

		uint32_t res = compact_fifo_mutex_pop(rx_fifo, &packet);

		if (res == CFIFO_OK) {
			cntr++;
			if (cntr != packet.counter) {
				printk("APP: Counter mismatch: %d != %d\n", cntr, packet.counter);
			}
			usb_send((uint8_t*)packet.raw);
		}
		
	}

	return 0;
}
/* ================================================================================================================== */
/* [INTR] Interrupts                                                                                                  */
/* ================================================================================================================== */
```

## include/critical.h
```c
#if defined(DISABLE_CRITICAL_REGIONS) || defined(UNITTEST)

#define ENTER_CRITICAL(_was_masked) do {\
} while(0)
#define EXIT_CRITICAL(_was_masked) do {\
} while(0)

#else


#define ENTER_CRITICAL(_was_masked) do {\
    __asm volatile ("MRS %0, primask" : "=r" (_was_masked) );\
    __asm volatile ("cpsid i" : : : "memory");\
} while(0)

#define EXIT_CRITICAL(_was_masked) do {\
    if (!_was_masked){\
        __asm volatile ("cpsie i" : : : "memory");\
    }\
} while(0)


#endif

#define CRITICAL_REGION(_code){     \
    uint32_t _was_masked;           \
    ENTER_CRITICAL(_was_masked);    \
    {_code}                         \
    EXIT_CRITICAL(_was_masked);     \
}
```

## include/packet.h
```c
#ifndef __PACKET_H__
#define __PACKET_H__
/* ======================================================================== */
/* [INCL] Includes                                                          */
/* ======================================================================== */
/* ------------------------  Standard  ------------------------------------ */
#include <stdint.h>
/* --------------------------  SDK  --------------------------------------- */

/* -------------------------  Plejd  -------------------------------------- */

/* -------------------------  Local  -------------------------------------- */

/* ======================================================================== */
/* [DEFS] Defines                                                           */
/* ======================================================================== */
#define __packed_gcc __attribute__((packed))
#define RBC_MESH_VALUE_MAX_LEN              (23UL)
#define BLE_ADV_PACKET_PAYLOAD_MAX_LENGTH   (31)
#define BLE_GAP_ADDR_LEN                    (6)

#define S0_FIELD_SIZE               (1)     /* This is set to 1 byte in the PCNF0 register in radio.c */

#define LENGTH_FIELD_SIZE           (1)     /* This is set to 6 bits in the PCNF0 register in radio.c.
                                            * For the field sizes defined in bits, the occupation in RAM will always be rounded
                                            * up to the next full byte size
                                            */

#define S1_FIELD_SIZE               (1)     /* This is set to 2 bits in the PCNF0 register in radio.c. Total length of LENGTH
                                            * and S1LEN fields must be 8 bits always.
                                            */

#define OVERHEAD_LENGTH             (S0_FIELD_SIZE + LENGTH_FIELD_SIZE + S1_FIELD_SIZE)

#define MAX_PACKET_PAYLOAD_LENGTH   (35)
#define MAX_RADIO_PACKET_LEN        (MAX_PACKET_PAYLOAD_LENGTH + OVERHEAD_LENGTH)
/* ======================================================================== */
/* [TYPE] Type definitions                                                  */
/* ======================================================================== */
typedef struct radio_packet_st {
    uint8_t raw[MAX_RADIO_PACKET_LEN];
    uint32_t timestamp;
    uint32_t counter;
    uint8_t channel;
} __attribute__((packed)) radio_packet_t;

typedef struct mesh_package_format_st {
    ble_header_t ble_header;
    
    rbc_header_t rbc_header;

    app_data_t plejd;
} __attribute__((packed)) mesh_package_format_t;
/* ======================================================================== */
/* [FDEF] Function declarations                                             */
/* ======================================================================== */
#endif /* __PACKET_H__ */
```
